## conf/distro/b-isdn-linux.conf
```bitbake
require conf/distro/poky.conf

DISTRO = "bisdn-linux"
DISTRO_NAME = "BISDN Linux"
DISTRO_VERSION = "1.0.0"

## I suggest to name releases after pizzas
## Our first release is supposed to be the 
## simple-most variant of the dish: 
## Marinara (basically a Margherita minus the cheese)
## We will work our way up from here

DISTRO_CODENAME = "Marinara"

DISTROOVERRIDES = "poky:linuxstdbase" 

EXTRAOPKGCONFIG   = "b-isdn-feed-config-opkg"

FEEDNAMEPREFIX ??= "basebox"
FEEDURIPREFIX  ??= "basebox"

FEEDDOMAIN     ??= "http://172.16.250.50"

DISTRO_FEATURES_append = " systemd"
VIRTUAL-RUNTIME_init_manager = "systemd"
DISTRO_FEATURES_BACKFILL_CONSIDERED = "sysvinit"
VIRTUAL-RUNTIME_initscripts = ""
```

## conf/distro/bisdn-linux.conf
```bitbake
require conf/distro/poky.conf

DISTRO = "bisdn-linux"
DISTRO_NAME = "BISDN Linux"
DISTRO_VERSION = "5.4.0"

DISTRO_CODENAME = "Ortolana"
DISTROOVERRIDES = "poky:bisdn-linux"

FEEDURIPREFIX  ??= "nightly_builds/${MACHINE}/main/packages_latest-build"
FEEDDOMAIN     ??= "http://repo.bisdn.de"

PACKAGE_FEED_URIS ??= "${FEEDDOMAIN}/${FEEDURIPREFIX}"
PACKAGE_FEED_BASE_PATHS ??= "ipk"
PACKAGEFEED_ARCHS ??= "all ${TUNE_PKGARCH} ${MACHINE_ARCH}"

DISTRO_FEATURES_DEFAULT ?= "acl argp ext2 ipv4 ipv6 largefile pci manpages systemd usbhost vfat virtualization xattr"

VIRTUAL-RUNTIME_init_manager = "systemd"
DISTRO_FEATURES_BACKFILL_CONSIDERED = "sysvinit pulseaudio"
VIRTUAL-RUNTIME_initscripts = ""

VIRTUAL-RUNTIME_login_manager = "systemd"
PREFERRED_PROVIDER_udev ?= "systemd"
PREFERRED_PROVIDER_udev-utils ?= "systemd"

BAD_RECOMMENDATIONS ?= "busybox-syslog"
DISTRO_FEATURES:remove = "alsa opengl wayland vulkan"

# disable symlinking of /var/volatile to /var/log to enable persistent logs
VOLATILE_LOG_DIR = "no"

PREFERRED_PROVIDER_virtual/docker = "docker-moby"
# we do not have seccomp in DISTRO_FEATURES, so do not enable it for docker
PACKAGECONFIG:pn-docker-moby ?= "docker-init"

# disable sensord to avoid pulling in rrdtool and various graphical dependencies
PACKAGECONFIG:pn-lmsensors ?= ""
PACKAGECONFIG:pn-lmsensors-config ?= ""

# use static uid/gid allocation to avoid renumeration on upgrade
USERADDEXTENSION = "useradd-staticids"
USERADD_ERROR_DYNAMIC = "error"
```

## conf/layer.conf
```bitbake
# We have a conf and classes directory, add to BBPATH
BBPATH .= ":${LAYERDIR}"

# We have recipes-* directories, add to BBFILES
BBFILES += "${LAYERDIR}/recipes-*/*/*.bb \
	${LAYERDIR}/recipes-*/*/*.bbappend"

BBFILE_COLLECTIONS += "bisdn-linux-layer"
BBFILE_PATTERN_bisdn-linux-layer = "^${LAYERDIR}/"
BBFILE_PRIORITY_bisdn-linux-layer = "9"

LAYERVERSION_bisdn-linux-layer = "1"

LAYERDEPENDS_bisdn-linux-layer = " \
  core \
  filesystems-layer \
  meta-python \
  networking-layer \
  openembedded-layer \
  openstack-layer \
  virtualization-layer \
  webserver \
"

LAYERSERIES_COMPAT_bisdn-linux-layer = "kirkstone"
```

## conf/machine/accton-csp7551.conf
```bitbake
#@TYPE: Machine
#@NAME: accton-csp7551

#@DESCRIPTION: Machine configuration for accton-csp7551 systems

PREFERRED_PROVIDER_virtual/kernel ?= "linux-yocto-onl"
PREFERRED_VERSION_linux-yocto-onl ?= "5.15%"

KMACHINE:accton-csp7551 = "x86_64-intel"
KERNEL_FEATURES += "bsp/x86_64-intel"

DEFAULTTUNE ?= "corei7-64"

# https://git.yoctoproject.org/poky/tree/meta/conf/machine/include?h=kirkstone
require conf/machine/include/x86/tune-corei7.inc
require conf/machine/include/x86/x86-base.inc

# https://github.com/bisdn/meta-open-network-linux/blob/main/conf/machine/include/onl.inc
require conf/machine/include/onl.inc

BISDN_SWITCH_IMAGE_EXTRA_INSTALL:remove = " \
    baseboxd \
    ofagent \
    ofdpa \
    ofdpa-grpc \
    ofdpa-tools \
    python3-ofdpa \
"

MACHINE_FEATURES += "pcbios efi"
MACHINE_FEATURES:remove = "alsa"

ONIE_VENDOR = "accton"
ONIE_MACHINE_TYPE = "csp7551"

MACHINE_EXTRA_RDEPENDS += " \
    accton-csp7551-mods \
    platform-onl-init \
"

# Firmware needed by qat and ice kernel modules (from poky's linux-firmware)
MACHINE_EXTRA_RDEPENDS += " \
    linux-firmware-ice \
    linux-firmware-ice-license \
    linux-firmware-qat \
    linux-firmware-qat-license \
"

# Allow configuration of BMC via ipmitool
MACHINE_EXTRA_RDEPENDS += " \
    ipmitool \
"

# Development tools
MACHINE_EXTRA_RDEPENDS += " \
    fping \
    iperf3 \
    net-tools \
    openvswitch \
    screen \
"
```
